#include "layers_definitions.dtsi"
#include "elpekenin/behaviors.dtsi"


/ {
	layer_callbacks {
		compatible = "elpekenin,layer-callback";
		layer_on {
			layer = <SYM>;
			event = "on-activation";
			bindings = <&kp F17>;
		};
		layer_off {
			layer = <SYM>;
			event = "on-deactivation";
			bindings = <&kp F18>;
		};
	};
};
