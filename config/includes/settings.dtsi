// Make sure this file is included before all other files

/*
* Layer Tap Settings
*/
&lt {
	// Increase layer tap time
	tapping-term-ms = <200>;
	
	// Quickly tap-tap-holding the lt button will repeat the tap behavior
	// For example enter-enter-hold, will output multiple enter while you
	// keep holding the key.
	// But holding enter without double tapping, will activate the layer.
	quick-tap-ms = <160>;
	
	flavor = "tap-preferred";
};


&soft_off {
	hold-time-ms = <2000>;// Only turn off it the key is held for 2 seconds or longer.
};
